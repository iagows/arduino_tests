//https://learn.adafruit.com/i31fl3731-16x9-charliplexed-pwm-led-driver/library-reference
//https://wiki.wemos.cc/products:retired:oled_shield_v1.1.0?s[]=64x48
//https://learn.adafruit.com/adafruit-gfx-graphics-library/graphics-primitives
#include <SPI.h>
#include <Wire.h>
#include <Adafruit_GFX.h>
#include <Adafruit_SSD1306.h>

// SCL GPIO5
// SDA GPIO4
#define RESET 2  // GPIO 2
Adafruit_SSD1306 display(RESET);

const uint16_t tamanho = sizeof(uint16_t);
static unsigned char valores[] = {
  0x00, 0x00, 0x00, 0x00, 0x00, 0x00, 0x00, 0x00, 
0x7d, 0xf1, 0x9f, 0x11, 0x86, 0x11, 0x91, 0x00, 
0x05, 0x30, 0x91, 0x10, 0x82, 0x10, 0x91, 0x00, 
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0x00, 0x00, 0x00, 0x00, 0x00, 0x00, 0x00, 0x00
};
bool changed = true;

void setup()   {
  //Serial.begin(9600);

  // by default, we'll generate the high voltage from the 3.3v line internally! (neat!)
  display.begin(SSD1306_SWITCHCAPVCC, 0x3C);  // initialize with the I2C addr 0x3C (for the 64x48)
  // init done

  // Show image buffer on the display hardware.
  // Since the buffer is intialized with an Adafruit splashscreen
  // internally, this will display the splashscreen.
  display.display();
  delay(500);

  if (changed) {
    // Clear the buffer.
    display.clearDisplay();

    uint16_t w = 64;
    uint16_t h = 31;
    uint16_t total = 15;
    uint16_t linha = 0;
    uint16_t coluna = 0;
    //Serial.print("Coluna:\t");
    for (int i = 0; i < w*h; ++i) {
      for (int x = 7; x > -1; x--) {

        if ((valores[i] >> x) & 0x1 > 0) {
          display.drawPixel(coluna, linha, WHITE);
        }
        //Serial.print((valores[i] >> x) & 0x1 > 0);

        
        coluna++;

        if (coluna == w) {
          //Serial.print("\nColuna:\t");

          coluna = 0;
          linha++;
        }
      }
    }
    display.display();
    delay(2000);
    changed = false;
  }
}

void loop() {

}
